## builder-lichee/builder-lichee_test_ddr/simon.its
```
/dts-v1/;
/ {
    description = "SimonOS with Custom Boot";
    #address-cells = <1>;
    images {
        firmware {
            description = "Simon Payload";
            data = /incbin/("image_simon_work.bin");
            type = "firmware";
            arch = "riscv";
            os = "u-boot";
            compression = "none";
            load = <0x40000000>;
            entry = <0x40000000>;
        };
    };
    configurations {
        default = "conf-1";
        conf-1 {
            description = "Boot Simon";
            firmware = "firmware";
        };
    };
};
```
