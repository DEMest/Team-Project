# ==============================================================================
# Файл: boot.S
# Назначение: Точка входа и Trap Handler для TH1520 (RISC-V 64-bit)
# ==============================================================================

# ------------------------------------------------------------------------------
# Константы Памяти и Периферии
# ------------------------------------------------------------------------------
.equ DRAM_BASE, 0x80000000      # Базовый адрес загрузки кода (FSBL/SPL)
.equ STACK_SIZE, 0x100000       # 1MB для стека
.equ STACK_TOP, DRAM_BASE + STACK_SIZE

.equ UART0_BASE, 0xFFE7014000   # Базовый адрес UART0 (стандартный для TH1520)
.equ UART_TX_REG, 0x00          # Смещение регистра данных (TX)

# ------------------------------------------------------------------------------
# Точка Входа
# ------------------------------------------------------------------------------
.section .text.init
.global _start
_start:
    # 1. Настройка Указателя Стека (sp)
    li sp, STACK_TOP           # Устанавливаем стек на 0x80100000
    
    # 2. Настройка Вектора Ловушки (mtvec)
    la t0, trap_handler        # Загружаем адрес обработчика
    csrw mtvec, t0             # Записываем его в mtvec
    
    # 3. Инициализация UART (минимальная)
    # В реальном коде здесь должна быть полная инициализация UART (скорость, формат)
    
    # 4. Основная Программа (имитация)
    call print_startup_msg     # Выводим сообщение о старте
    
    # Имитация ошибки: попытка выполнить недопустимую инструкцию
    .word 0x00000000           # Недопустимая инструкция (вызовет исключение 2)
    
    # Бесконечный цикл (если ошибка не произошла)
    loop:
        j loop

# ------------------------------------------------------------------------------
# Вывод Строки
# ------------------------------------------------------------------------------
# Вход: a0 = адрес строки (заканчивается нулем)
print_string:
    mv t0, a0                  # t0 = указатель на строку
1:
    lbu a0, 0(t0)              # Загружаем байт (символ)
    beqz a0, 2f                # Если 0, то конец строки, выход
    call putc                  # Выводим символ
    addi t0, t0, 1             # Переходим к следующему символу
    j 1b
2:
    ret

# ------------------------------------------------------------------------------
# Вывод 64-битного Hex-числа
# ------------------------------------------------------------------------------
# Вход: a0 = 64-битное число для вывода
print_hex:
    li t0, 16                  # t0 = счетчик символов (16 для 64-бит)
    li t1, 60                  # t1 = бит, с которого начинаем (60 = 15 * 4)
    
hex_loop:
    # 1. Извлекаем 4 бита (один hex-символ)
    srl t2, a0, t1             # Сдвигаем a0 вправо на t1 бит
    andi t2, t2, 0xF           # Маскируем, чтобы оставить только 4 младших бита
    
    # 2. Преобразуем 4 бита в ASCII
    li t3, 10
    blt t2, t3, is_digit       # Если t2 < 10, это цифра (0-9)
    
    # Если это буква (A-F)
    addi t2, t2, 'A' - 10      # t2 = t2 + 55 (ASCII 'A' = 65)
    j print_char
    
is_digit:
    addi t2, t2, '0'           # t2 = t2 + 48 (ASCII '0' = 48)
    
print_char:
    mv a1, t2                  # Сохраняем символ в a1
    mv a0, a1                  # Перемещаем ASCII символ в a0 для putc
    call putc                  # Вызываем putc для вывода символа
    
    # 3. Обновляем счетчики
    addi t0, t0, -1            # Декрементируем счетчик символов
    addi t1, t1, -4            # Сдвигаем на 4 бита влево
    bnez t0, hex_loop          # Если t0 != 0, продолжаем
    
    ret

# ------------------------------------------------------------------------------
# Вывод Одного Символа (putc)
# ------------------------------------------------------------------------------
# Вход: a0 = символ для вывода
putc:
    # В реальном коде здесь должна быть проверка готовности TX FIFO
    li t0, UART0_BASE
    sb a0, UART_TX_REG(t0)     # Сохранить байт (sb) из a0 в регистр данных
    
    # Очень короткая задержка (для симуляции)
    li t0, 100
1:  addi t0, t0, -1
    bnez t0, 1b
    
    ret

# ------------------------------------------------------------------------------
# Вывод Сообщения о Старте
# ------------------------------------------------------------------------------
print_startup_msg:
    la a0, startup_msg
    call print_string
    ret

# ------------------------------------------------------------------------------
# Обработчик Ловушек (Trap Handler)
# ------------------------------------------------------------------------------
.global trap_handler
trap_handler:
    # 1. Сохранение контекста (минимальное, для работы функций вывода)
    # В полном обработчике нужно сохранять ВСЕ регистры (x1-x31)
    
    # 2. Вывод заголовка
    la a0, trap_msg
    call print_string
    
    # 3. Чтение и вывод mcause (Причина)
    la a0, cause_msg
    call print_string
    csrr a0, mcause            # Читаем mcause в a0
    call print_hex             # Выводим mcause
    
    # 4. Чтение и вывод mepc (Адрес Ошибки)
    la a0, mepc_msg
    call print_string
    csrr a0, mepc              # Читаем mepc в a0
    call print_hex             # Выводим mepc
    
    # 5. Остановка
    la a0, halt_msg
    call print_string
    
    halt:
        j halt                 # Бесконечный цикл

# ------------------------------------------------------------------------------
# Секция Данных
# ------------------------------------------------------------------------------
.section .rodata
startup_msg: .asciz "TH1520 Bare-Metal: Starting program...\n"
trap_msg:    .asciz "\n!!! MACHINE TRAP OCCURRED !!!\n"
cause_msg:   .asciz "CAUSE: 0x"
mepc_msg:    .asciz "\nMEPC: 0x"
halt_msg:    .asciz "\nSystem Halted.\n"

# ------------------------------------------------------------------------------
# Секция BSS (неинициализированные данные)
# ------------------------------------------------------------------------------
.section .bss
.align 3
stack_space: .skip STACK_SIZE

